## layers/meta-orin-nano/conf/layer.conf
```bitbake
BBPATH .= ":${LAYERDIR}"

BBFILES += "${LAYERDIR}/recipes-*/*/*.bb \
            ${LAYERDIR}/recipes-*/*/*.bbappend"

BBFILE_COLLECTIONS += "orinnano"
BBFILE_PATTERN_orinnano = "^${LAYERDIR}/"
BBFILE_PRIORITY_orinnano = "6"

LAYERSERIES_COMPAT_orinnano = "wrynose"
LAYERDEPENDS_orinnano = "core tegra"
```
