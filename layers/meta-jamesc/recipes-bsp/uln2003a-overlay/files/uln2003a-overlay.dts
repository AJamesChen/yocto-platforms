/dts-v1/;
/plugin/;

/ {
    compatible = "brcm,bcm2711";
    fragment@0 {
        target-path = "/";
        __overlay__ {
            uln2003a: uln2003a {
                compatible = "jamesc,uln2003a-stepper";
                /* IN1, IN2, IN3, IN4; GPIO_ACTIVE_HIGH = 0. */
                coil-gpios = <&gpio 12 0>, <&gpio 19 0>,
                             <&gpio 20 0>, <&gpio 21 0>;
                status = "okay";
            };
        };
    };
    __overrides__ {
        in1 = <&uln2003a>, "coil-gpios:4";
        in2 = <&uln2003a>, "coil-gpios:16";
        in3 = <&uln2003a>, "coil-gpios:28";
        in4 = <&uln2003a>, "coil-gpios:40";
        reverse = <&uln2003a>, "reverse-direction?";
    };
};
