/dts-v1/;
/plugin/;

/ {
    compatible = "brcm,bcm2711";

    fragment@0 {
        target = <&spi0>;

        __overlay__ {
            status = "okay";
        };
    };

    fragment@1 {
        target = <&spidev0>;

        __overlay__ {
            compatible = "nxp,mfrc522";
            spi-max-frequency = <1000000>;
            reset-gpios = <&gpio 25 1>;
            status = "okay";
        };
    };
};
